## build~/conf/bblayers.conf
```bitbake
# POKY_BBLAYERS_CONF_VERSION is increased each time build/conf/bblayers.conf
# changes incompatibly
POKY_BBLAYERS_CONF_VERSION = "2"

BBPATH = "${TOPDIR}"
BBFILES ?= ""

BBLAYERS ?= " \
  /home/mjoshi/assignment-6-mishajoshi/poky/meta \
  /home/mjoshi/assignment-6-mishajoshi/poky/meta-poky \
  /home/mjoshi/assignment-6-mishajoshi/poky/meta-yocto-bsp \
  "
```
